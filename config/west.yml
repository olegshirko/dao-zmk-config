## config/west.yml
```yaml
manifest:
  remotes:
    - name: zmkfirmware
      url-base: https://github.com/zmkfirmware
  projects:
    - name: zmk
      remote: zmkfirmware
      revision: dependabot/github_actions/actions/upload-artifact-3
      import: app/west.yml
  self:
    path: config
```
